# file: targetBoard_M450_RASPI_2V0_20260703.ioc
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ADC1.Channel-0\#ChannelRegularConversion=ADC_CHANNEL_10
ADC1.Channel-1\#ChannelRegularConversion=ADC_CHANNEL_11
ADC1.Channel-10\#ChannelRegularConversion=ADC_CHANNEL_3
ADC1.Channel-11\#ChannelRegularConversion=ADC_CHANNEL_6
ADC1.Channel-12\#ChannelRegularConversion=ADC_CHANNEL_7
ADC1.Channel-13\#ChannelRegularConversion=ADC_CHANNEL_14
ADC1.Channel-14\#ChannelRegularConversion=ADC_CHANNEL_15
ADC1.Channel-15\#ChannelRegularConversion=ADC_CHANNEL_8
ADC1.Channel-2\#ChannelRegularConversion=ADC_CHANNEL_12
ADC1.Channel-3\#ChannelRegularConversion=ADC_CHANNEL_13
ADC1.Channel-4\#ChannelRegularConversion=ADC_CHANNEL_TEMPSENSOR
ADC1.Channel-5\#ChannelRegularConversion=ADC_CHANNEL_VREFINT
ADC1.Channel-6\#ChannelRegularConversion=ADC_CHANNEL_VBAT
ADC1.Channel-7\#ChannelRegularConversion=ADC_CHANNEL_1
ADC1.Channel-8\#ChannelRegularConversion=ADC_CHANNEL_0
ADC1.Channel-9\#ChannelRegularConversion=ADC_CHANNEL_2
ADC1.ContinuousConvMode=ENABLE
ADC1.DMAContinuousRequests=ENABLE
ADC1.NbrOfConversion=16
ADC1.NbrOfConversionFlag=1
ADC1.Rank-0\#ChannelRegularConversion=1
ADC1.Rank-1\#ChannelRegularConversion=2
ADC1.Rank-10\#ChannelRegularConversion=11
ADC1.Rank-11\#ChannelRegularConversion=12
ADC1.Rank-12\#ChannelRegularConversion=13
ADC1.Rank-13\#ChannelRegularConversion=14
ADC1.Rank-14\#ChannelRegularConversion=15
ADC1.Rank-15\#ChannelRegularConversion=16
ADC1.Rank-2\#ChannelRegularConversion=3
ADC1.Rank-3\#ChannelRegularConversion=4
ADC1.Rank-4\#ChannelRegularConversion=5
ADC1.Rank-5\#ChannelRegularConversion=6
ADC1.Rank-6\#ChannelRegularConversion=7
ADC1.Rank-7\#ChannelRegularConversion=8
ADC1.Rank-8\#ChannelRegularConversion=9
ADC1.Rank-9\#ChannelRegularConversion=10
ADC1.SamplingTime-0\#ChannelRegularConversion=ADC_SAMPLETIME_144CYCLES
ADC1.SamplingTime-1\#ChannelRegularConversion=ADC_SAMPLETIME_144CYCLES
ADC1.SamplingTime-10\#ChannelRegularConversion=ADC_SAMPLETIME_144CYCLES
ADC1.SamplingTime-11\#ChannelRegularConversion=ADC_SAMPLETIME_144CYCLES
ADC1.SamplingTime-12\#ChannelRegularConversion=ADC_SAMPLETIME_144CYCLES
ADC1.SamplingTime-13\#ChannelRegularConversion=ADC_SAMPLETIME_144CYCLES
ADC1.SamplingTime-14\#ChannelRegularConversion=ADC_SAMPLETIME_144CYCLES
ADC1.SamplingTime-15\#ChannelRegularConversion=ADC_SAMPLETIME_144CYCLES
ADC1.SamplingTime-2\#ChannelRegularConversion=ADC_SAMPLETIME_144CYCLES
ADC1.SamplingTime-3\#ChannelRegularConversion=ADC_SAMPLETIME_144CYCLES
ADC1.SamplingTime-4\#ChannelRegularConversion=ADC_SAMPLETIME_144CYCLES
ADC1.SamplingTime-5\#ChannelRegularConversion=ADC_SAMPLETIME_144CYCLES
ADC1.SamplingTime-6\#ChannelRegularConversion=ADC_SAMPLETIME_144CYCLES
ADC1.SamplingTime-7\#ChannelRegularConversion=ADC_SAMPLETIME_144CYCLES
ADC1.SamplingTime-8\#ChannelRegularConversion=ADC_SAMPLETIME_144CYCLES
ADC1.SamplingTime-9\#ChannelRegularConversion=ADC_SAMPLETIME_144CYCLES
ADC1.ScanConvMode=ENABLE
ADC1.master=1
CAN1.ABOM=ENABLE
CAN1.BS1=CAN_BS1_11TQ
CAN1.BS2=CAN_BS2_2TQ
CAN1.CalculateBaudRate=1000000
CAN1.CalculateTimeBit=1000
CAN1.CalculateTimeQuantum=71.42857142857143
CAN1.NART=ENABLE
CAN1.Prescaler=3
CAN2.ABOM=ENABLE
CAN2.BS1=CAN_BS1_11TQ
CAN2.BS2=CAN_BS2_2TQ
CAN2.CalculateBaudRate=1000000
CAN2.CalculateTimeBit=1000
CAN2.CalculateTimeQuantum=71.42857142857143
CAN2.NART=ENABLE
CAN2.Prescaler=3
DAC.DAC_Trigger=DAC_TRIGGER_NONE
DAC.DAC_Trigger2=DAC_TRIGGER_NONE
Dma.ADC1.0.Direction=DMA_PERIPH_TO_MEMORY
Dma.ADC1.0.FIFOMode=DMA_FIFOMODE_DISABLE
Dma.ADC1.0.Instance=DMA2_Stream0
Dma.ADC1.0.MemDataAlignment=DMA_MDATAALIGN_HALFWORD
Dma.ADC1.0.MemInc=DMA_MINC_ENABLE
Dma.ADC1.0.Mode=DMA_NORMAL
Dma.ADC1.0.PeriphDataAlignment=DMA_PDATAALIGN_HALFWORD
Dma.ADC1.0.PeriphInc=DMA_PINC_DISABLE
Dma.ADC1.0.Priority=DMA_PRIORITY_LOW
Dma.Request0=ADC1
Dma.Request1=SPI2_RX
Dma.Request2=SPI2_TX
Dma.SPI2_RX.1.Direction=DMA_PERIPH_TO_MEMORY
Dma.SPI2_RX.1.FIFOMode=DMA_FIFOMODE_DISABLE
Dma.SPI2_RX.1.Instance=DMA1_Stream3
Dma.SPI2_RX.1.MemDataAlignment=DMA_MDATAALIGN_BYTE
Dma.SPI2_RX.1.MemInc=DMA_MINC_ENABLE
Dma.SPI2_RX.1.Mode=DMA_NORMAL
Dma.SPI2_RX.1.PeriphDataAlignment=DMA_PDATAALIGN_BYTE
Dma.SPI2_RX.1.PeriphInc=DMA_PINC_DISABLE
Dma.SPI2_RX.1.Priority=DMA_PRIORITY_HIGH
Dma.SPI2_TX.2.Direction=DMA_MEMORY_TO_PERIPH
Dma.SPI2_TX.2.FIFOMode=DMA_FIFOMODE_DISABLE
Dma.SPI2_TX.2.Instance=DMA1_Stream4
Dma.SPI2_TX.2.MemDataAlignment=DMA_MDATAALIGN_BYTE
Dma.SPI2_TX.2.MemInc=DMA_MINC_ENABLE
Dma.SPI2_TX.2.Mode=DMA_NORMAL
Dma.SPI2_TX.2.PeriphDataAlignment=DMA_PDATAALIGN_BYTE
Dma.SPI2_TX.2.PeriphInc=DMA_PINC_DISABLE
Dma.SPI2_TX.2.Priority=DMA_PRIORITY_HIGH
FATFS._CODE_PAGE=437
FATFS._FS_EXFAT=1
FATFS._FS_LOCK=255
FATFS._STRF_ENCODE=0
FATFS._USE_CHMOD=1
FATFS._USE_EXPAND=1
FATFS._USE_FIND=1
FATFS._USE_FORWARD=1
FATFS._USE_LABEL=1
FATFS._USE_LFN=3
FATFS._USE_MUTEX=1
FREERTOS.Tasks01=defaultTask,24,128,StartDefaultTask,Default,NULL,Dynamic,NULL,NULL;mainAppTask,24,8192,StartMainAppTask,As external,NULL,Dynamic,NULL,NULL
FREERTOS.configENABLE_FPU=1
FREERTOS.configTOTAL_HEAP_SIZE=49152
FREERTOS.configUSE_APPLICATION_TASK_TAG=1
Mcu.Family=STM32F4
Mcu.Name=STM32F407I(E-G)Tx
Mcu.Package=LQFP176
NVIC.CAN1_RX0_IRQn=true\:5\:0\:false\:false\:true\:true\:true\:true\:true
NVIC.CAN2_RX0_IRQn=true\:5\:0\:false\:false\:true\:true\:true\:true\:true
NVIC.DMA1_Stream3_IRQn=true\:5\:0\:false\:false\:true\:true\:false\:true\:true
NVIC.DMA1_Stream4_IRQn=true\:5\:0\:false\:false\:true\:true\:false\:true\:true
NVIC.DMA2_Stream0_IRQn=true\:5\:0\:false\:false\:true\:true\:false\:true\:true
NVIC.OTG_FS_IRQn=true\:5\:0\:false\:false\:true\:true\:false\:true\:true
NVIC.PriorityGroup=NVIC_PRIORITYGROUP_4
NVIC.SPI2_IRQn=true\:5\:0\:false\:false\:true\:true\:true\:true\:true
NVIC.TIM1_UP_TIM10_IRQn=true\:5\:0\:false\:false\:true\:true\:true\:true\:true
NVIC.TIM8_TRG_COM_TIM14_IRQn=true\:5\:0\:false\:false\:true\:true\:true\:true\:true
NVIC.TIM8_UP_TIM13_IRQn=true\:15\:0\:false\:false\:true\:false\:false\:true\:true
NVIC.TimeBase=TIM8_UP_TIM13_IRQn
NVIC.TimeBaseIP=TIM13
NVIC.USART3_IRQn=true\:5\:0\:false\:false\:true\:true\:true\:true\:true
PA0-WKUP.Signal=ADCx_IN0
PA1.Signal=ADCx_IN1
PA10.GPIO_Label=MPU_UART_RX
PA10.GPIO_PuPd=GPIO_PULLDOWN
PA10.GPIO_Speed=GPIO_SPEED_FREQ_HIGH
PA10.Mode=Asynchronous
PA10.Signal=USART1_RX
PA11.GPIO_Label=USB_OTG_FS_DM
PA11.Mode=Host_Only
PA11.Signal=USB_OTG_FS_DM
PA12.GPIO_Label=USB_OTG_FS_DP
PA12.Mode=Host_Only
PA12.Signal=USB_OTG_FS_DP
PA13.GPIO_Label=SWDIO
PA13.Mode=Trace_Asynchronous_SW
PA13.Signal=SYS_JTMS-SWDIO
PA14.GPIO_Label=SWCLK
PA14.Mode=Trace_Asynchronous_SW
PA14.Signal=SYS_JTCK-SWCLK
PA15.GPIO_Label=EPROM_NSS
PA15.GPIO_PuPd=GPIO_PULLUP
PA15.GPIO_Speed=GPIO_SPEED_FREQ_VERY_HIGH
PA15.Signal=GPIO_Output
PA2.Signal=ADCx_IN2
PA3.Signal=ADCx_IN3
PA4.GPIO_Label=TEC0_SET
PA4.Signal=COMP_DAC1_group
PA5.GPIO_Label=TEC1_SET
PA5.Signal=COMP_DAC2_group
PA6.Signal=ADCx_IN6
PA7.Signal=ADCx_IN7
PA8.GPIO_Label=IBUS_SCL
PA8.GPIO_Pu=GPIO_PULLUP
PA8.GPIO_Speed=GPIO_SPEED_FREQ_HIGH
PA8.Mode=I2C
PA8.Signal=I2C3_SCL
PA9.GPIO_Label=MPU_UART_TX
PA9.GPIO_PuPd=GPIO_PULLDOWN
PA9.GPIO_Speed=GPIO_SPEED_FREQ_HIGH
PA9.Mode=Asynchronous
PA9.Signal=USART1_TX
PB0.Signal=ADCx_IN8
PB1.Signal=ADCx_IN9
PB10.Mode=I2C
PB10.Signal=I2C2_SCL
PB11.Mode=I2C
PB11.Signal=I2C2_SDA
PB12.GPIO_Label=ICAN_RX
PB12.Mode=CAN_Activate
PB12.Signal=CAN2_RX
PB13.GPIO_Label=ICAN_TX
PB13.Mode=CAN_Activate
PB13.Signal=CAN2_TX
PB14.GPIO_Label=YOUT1
PB14.GPIO_PuPd=GPIO_PULLUP
PB14.PinState=GPIO_PIN_SET
PB14.Signal=GPIO_Output
PB15.GPIO_Label=LAS_TRAFFIC
PB15.GPIO_PuPd=GPIO_PULLUP
PB15.Signal=GPIO_Input
PB3.GPIO_Label=SWO
PB3.Mode=Trace_Asynchronous_SW
PB3.Signal=SYS_JTDO-SWO
PB5.GPIO_Label=EPROM_MOSI
PB5.GPIO_PuPd=GPIO_PULLDOWN
PB5.Mode=Full_Duplex_Master
PB5.Signal=SPI3_MOSI
PB6.GPIO_Label=PUMP1_PWM
PB6.GPIO_PuPd=GPIO_PULLDOWN
PB6.GPIO_Speed=GPIO_SPEED_FREQ_HIGH
PB6.Signal=GPIO_Output
PB7.GPIO_Label=PUMP0_PWM
PB7.GPIO_PuPd=GPIO_PULLDOWN
PB7.GPIO_Speed=GPIO_SPEED_FREQ_HIGH
PB7.Signal=GPIO_Output
PB8.GPIO_Label=ECAN_RX
PB8.Mode=CAN_Activate
PB8.Signal=CAN1_RX
PB9.GPIO_Label=ECAN_TX
PB9.Mode=CAN_Activate
PB9.Signal=CAN1_TX
PC0.Signal=ADCx_IN10
PC1.Signal=ADCx_IN11
PC10.GPIO_Label=EPROM_SCK
PC10.GPIO_PuPd=GPIO_PULLDOWN
PC10.Mode=Full_Duplex_Master
PC10.Signal=SPI3_SCK
PC11.GPIO_Label=EPROM_MISO
PC11.GPIO_PuPd=GPIO_PULLDOWN
PC11.Mode=Full_Duplex_Master
PC11.Signal=SPI3_MISO
PC12.GPIO_Label=DBG_TX
PC12.GPIO_PuPd=GPIO_PULLDOWN
PC12.GPIO_Speed=GPIO_SPEED_FREQ_HIGH
PC12.Mode=Asynchronous
PC12.Signal=UART5_TX
PC2.Signal=ADCx_IN12
PC3.Signal=ADCx_IN13
PC4.Signal=ADCx_IN14
PC5.Signal=ADCx_IN15
PC6.GPIO_Label=MHI_UART_TX
PC6.GPIO_PuPd=GPIO_PULLDOWN
PC6.GPIO_Speed=GPIO_SPEED_FREQ_HIGH
PC6.Mode=Asynchronous
PC6.Signal=USART6_TX
PC7.GPIO_Label=HMI_UART_RX
PC7.GPIO_PuPd=GPIO_PULLDOWN
PC7.GPIO_Speed=GPIO_SPEED_FREQ_HIGH
PC7.Mode=Asynchronous
PC7.Signal=USART6_RX
PC8.GPIO_Label=POWER_KILL
PC8.GPIO_ModeDefaultOutputPP=GPIO_MODE_OUTPUT_OD
PC8.GPIO_PuPd=GPIO_NOPULL
PC8.PinState=GPIO_PIN_SET
PC8.Signal=GPIO_Output
PC9.GPIO_Label=IBUS_SDA
PC9.GPIO_Pu=GPIO_PULLUP
PC9.GPIO_Speed=GPIO_SPEED_FREQ_HIGH
PC9.Mode=I2C
PC9.Signal=I2C3_SDA
PD0.GPIO_Label=HDMI_VCC_EA
PD0.GPIO_PuPd=GPIO_PULLDOWN
PD0.Signal=GPIO_Output
PD1.GPIO_Label=MPU_INT0
PD1.Signal=GPIO_Input
PD10.GPIO_Label=IBUS_INT0
PD10.GPIO_PuPd=GPIO_PULLUP
PD10.Signal=GPIO_Input
PD11.GPIO_Label=IBUS_INT3
PD11.GPIO_PuPd=GPIO_PULLUP
PD11.Signal=GPIO_Input
PD12.GPIO_Label=IBUS_INT2
PD12.GPIO_PuPd=GPIO_PULLUP
PD12.Signal=GPIO_Input
PD13.GPIO_Label=PCA9546_RESET
PD13.GPIO_PuPd=GPIO_PULLUP
PD13.PinState=GPIO_PIN_SET
PD13.Signal=GPIO_Output
PD14.GPIO_Label=IBUS_INT4
PD14.Signal=GPIO_Input
PD15.GPIO_Label=IBUS_INT5
PD15.Signal=GPIO_Input
PD2.GPIO_Label=DBG_RX
PD2.GPIO_PuPd=GPIO_PULLDOWN
PD2.GPIO_Speed=GPIO_SPEED_FREQ_HIGH
PD2.Mode=Asynchronous
PD2.Signal=UART5_RX
PD3.GPIO_Label=MPU_INT1
PD3.Signal=GPIO_Input
PD4.GPIO_Label=MPU_INT2
PD4.Signal=GPIO_Input
PD5.GPIO_Label=MPU_INT3
PD5.Signal=GPIO_Input
PD6.GPIO_Label=TPL0501_SPI3_NSS
PD6.GPIO_ModeDefaultOutputPP=GPIO_MODE_OUTPUT_PP
PD6.GPIO_PuPd=GPIO_PULLUP
PD6.GPIO_Speed=GPIO_SPEED_FREQ_HIGH
PD6.PinState=GPIO_PIN_SET
PD6.Signal=GPIO_Output
PD7.GPIO_Label=TPL0501_SPI3_SCK
PD7.GPIO_PuPd=GPIO_PULLUP
PD7.GPIO_Speed=GPIO_SPEED_FREQ_HIGH
PD7.PinState=GPIO_PIN_SET
PD7.Signal=GPIO_Output
PD8.GPIO_Label=GDDC_UART_TX
PD8.GPIO_PuPd=GPIO_PULLDOWN
PD8.GPIO_Speed=GPIO_SPEED_FREQ_HIGH
PD8.Mode=Asynchronous
PD8.Signal=USART3_TX
PD9.GPIO_Label=GDDC_UART_RX
PD9.GPIO_PuPd=GPIO_PULLDOWN
PD9.GPIO_Speed=GPIO_SPEED_FREQ_HIGH
PD9.Mode=Asynchronous
PD9.Signal=USART3_RX
PE10.GPIO_Label=LAS6_PWM
PE10.GPIO_PuPd=GPIO_PULLDOWN
PE10.Signal=GPIO_Output
PE11.GPIO_Label=TEC_BREAK
PE11.GPIO_PuPd=GPIO_PULLUP
PE11.PinState=GPIO_PIN_SET
PE11.Signal=GPIO_Output
PE12.GPIO_Label=TEC0_PWM
PE12.GPIO_PuPd=GPIO_PULLDOWN
PE12.Signal=GPIO_Output
PE13.GPIO_Label=TEC2_PWM
PE13.GPIO_PuPd=GPIO_PULLDOWN
PE13.Signal=GPIO_Output
PE14.GPIO_Label=TEC4_PWM
PE14.GPIO_PuPd=GPIO_PULLDOWN
PE14.Signal=GPIO_Output
PE15.GPIO_Label=TEC6_PWM
PE15.GPIO_PuPd=GPIO_PULLDOWN
PE15.Signal=GPIO_Output
PE2.GPIO_Label=STA0_LED
PE2.GPIO_ModeDefaultOutputPP=GPIO_MODE_OUTPUT_OD
PE2.GPIO_PuPd=GPIO_NOPULL
PE2.PinState=GPIO_PIN_SET
PE2.Signal=GPIO_Output
PE3.GPIO_Label=STA1_LED
PE3.GPIO_ModeDefaultOutputPP=GPIO_MODE_OUTPUT_OD
PE3.GPIO_PuPd=GPIO_NOPULL
PE3.PinState=GPIO_PIN_SET
PE3.Signal=GPIO_Output
PE4.GPIO_Label=STA2_LED
PE4.GPIO_ModeDefaultOutputPP=GPIO_MODE_OUTPUT_OD
PE4.GPIO_PuPd=GPIO_NOPULL
PE4.PinState=GPIO_PIN_SET
PE4.Signal=GPIO_Output
PE5.GPIO_Label=STA3_LED
PE5.GPIO_ModeDefaultOutputPP=GPIO_MODE_OUTPUT_OD
PE5.GPIO_PuPd=GPIO_NOPULL
PE5.PinState=GPIO_PIN_SET
PE5.Signal=GPIO_Output
PE6.GPIO_Label=SPK_PWM
PE6.GPIO_PuPd=GPIO_PULLDOWN
PE6.Signal=S_TIM9_CH2
PE7.GPIO_Label=LAS5_PWM
PE7.GPIO_PuPd=GPIO_PULLDOWN
PE7.Signal=GPIO_Output
PE8.GPIO_Label=LAS7_PWM
PE8.GPIO_PuPd=GPIO_PULLDOWN
PE8.Signal=GPIO_Output
PE9.GPIO_Label=LAS4_PWM
PE9.GPIO_PuPd=GPIO_PULLDOWN
PE9.Signal=GPIO_Output
PF0.GPIO_Label=SGATE_EN
PF0.GPIO_PuPd=GPIO_PULLDOWN
PF0.Signal=GPIO_Output
PF1.GPIO_Label=INTRUSION_NC
PF1.Signal=GPIO_Input
PF10.GPIO_Label=POWER_LED
PF10.GPIO_PuPd=GPIO_PULLDOWN
PF10.Signal=GPIO_Output
PF11.GPIO_Label=AIM0_ENABLE
PF11.GPIO_PuPd=GPIO_PULLUP
PF11.PinState=GPIO_PIN_SET
PF11.Signal=GPIO_Output
PF12.GPIO_Label=AIM1_ENABLE
PF12.GPIO_PuPd=GPIO_PULLUP
PF12.PinState=GPIO_PIN_SET
PF12.Signal=GPIO_Output
PF13.GPIO_Label=DAC8568_CLEAR
PF13.GPIO_PuPd=GPIO_PULLUP
PF13.PinState=GPIO_PIN_SET
PF13.Signal=GPIO_Output
PF14.GPIO_Label=LAS1_PWM
PF14.GPIO_PuPd=GPIO_PULLDOWN
PF14.Signal=GPIO_Output
PF15.GPIO_Label=LAS3_PWM
PF15.GPIO_PuPd=GPIO_PULLDOWN
PF15.Signal=GPIO_Output
PF2.GPIO_Label=SGATE_NC
PF2.Signal=GPIO_Input
PF3.GPIO_Label=SAFE_RESET
PF3.GPIO_PuPd=GPIO_PULLDOWN
PF3.Signal=GPIO_Output
PF4.GPIO_Label=SPK_EN
PF4.GPIO_PuPd=GPIO_PULLDOWN
PF4.Signal=GPIO_Output
PF5.GPIO_Label=MCP41010_SDI
PF5.GPIO_PuPd=GPIO_PULLDOWN
PF5.Signal=GPIO_Output
PF6.GPIO_Label=MCP41010_SCK
PF6.GPIO_PuPd=GPIO_PULLDOWN
PF6.Signal=GPIO_Output
PF7.GPIO_Label=MCP41010_CS
PF7.GPIO_PuPd=GPIO_PULLDOWN
PF7.PinState=GPIO_PIN_SET
PF7.Signal=GPIO_Output
PF8.GPIO_Label=RED_LED
PF8.GPIO_PuPd=GPIO_PULLDOWN
PF8.Signal=GPIO_Output
PF9.GPIO_Label=BLUE_LED
PF9.GPIO_PuPd=GPIO_PULLDOWN
PF9.Signal=GPIO_Output
PG0.GPIO_Label=LAS0_PWM
PG0.GPIO_PuPd=GPIO_PULLUP
PG0.Signal=GPIO_Output
PG1.GPIO_Label=LAS2_PWM
PG1.GPIO_PuPd=GPIO_PULLDOWN
PG1.Signal=GPIO_Output
PG10.GPIO_Label=LCM3000_EEPROM_PROTECT
PG10.GPIO_PuPd=GPIO_PULLUP
PG10.PinState=GPIO_PIN_SET
PG10.Signal=GPIO_Output
PG11.GPIO_Label=TPL0501_SPI3_MOSI
PG11.GPIO_PuPd=GPIO_PULLDOWN
PG11.GPIO_Speed=GPIO_SPEED_FREQ_HIGH
PG11.PinState=GPIO_PIN_RESET
PG11.Signal=GPIO_Output
PG12.GPIO_Label=IBUS_INT1
PG12.Signal=GPIO_Input
PG14.GPIO_Label=HDC1080_SDA
PG14.GPIO_ModeDefaultOutputPP=GPIO_MODE_OUTPUT_OD
PG14.GPIO_PuPd=GPIO_NOPULL
PG14.GPIO_Speed=GPIO_SPEED_FREQ_VERY_HIGH
PG14.PinState=GPIO_PIN_SET
PG14.Signal=GPIO_Output
PG15.GPIO_Label=HDC1080_SCL
PG15.GPIO_ModeDefaultOutputPP=GPIO_MODE_OUTPUT_OD
PG15.GPIO_PuPd=GPIO_NOPULL
PG15.GPIO_Speed=GPIO_SPEED_FREQ_HIGH
PG15.PinState=GPIO_PIN_SET
PG15.Signal=GPIO_Output
PG2.GPIO_Label=IBUS_INT6
PG2.Signal=GPIO_Input
PG3.GPIO_Label=ESTOP_NC
PG3.Signal=GPIO_Input
PG4.GPIO_Label=INTERLOCK_NC
PG4.GPIO_PuPd=GPIO_PULLUP
PG4.Signal=GPIO_Input
PG5.GPIO_Label=SKEY_NO
PG5.GPIO_PuPd=GPIO_PULLUP
PG5.Signal=GPIO_Input
PG6.GPIO_Label=FS_NC
PG6.GPIO_PuPd=GPIO_PULLUP
PG6.Signal=GPIO_Input
PG7.GPIO_Label=FS_NO
PG7.GPIO_PuPd=GPIO_PULLUP
PG7.Signal=GPIO_Input
PG8.GPIO_Label=G_DCOK
PG8.Signal=GPIO_Input
PG9.GPIO_Label=LCM3000_I2C_EN
PG9.GPIO_PuPd=GPIO_PULLDOWN
PG9.Signal=GPIO_Output
PH0-OSC_IN.Mode=HSE-External-Oscillator
PH0-OSC_IN.Signal=RCC_OSC_IN
PH1-OSC_OUT.Mode=HSE-External-Oscillator
PH1-OSC_OUT.Signal=RCC_OSC_OUT
PH10.GPIO_Label=YOUT0
PH10.GPIO_ModeDefaultOutputPP=GPIO_MODE_OUTPUT_PP
PH10.GPIO_PuPd=GPIO_PULLUP
PH10.PinState=GPIO_PIN_SET
PH10.Signal=GPIO_Output
PH11.GPIO_Label=GAIM_SHDN
PH11.GPIO_PuPd=GPIO_PULLUP
PH11.PinState=GPIO_PIN_SET
PH11.Signal=GPIO_Output
PH12.GPIO_Label=GAIM_PWM
PH12.GPIO_PuPd=GPIO_PULLDOWN
PH12.Signal=S_TIM5_CH3
PH13.GPIO_Label=MPU_RST
PH13.GPIO_ModeDefaultOutputPP=GPIO_MODE_OUTPUT_OD
PH13.GPIO_PuPd=GPIO_NOPULL
PH13.PinState=GPIO_PIN_SET
PH13.Signal=GPIO_Output
PH14.GPIO_Label=MPU_EN
PH14.GPIO_PuPd=GPIO_PULLDOWN
PH14.PinState=GPIO_PIN_RESET
PH14.Signal=GPIO_Output
PH15.GPIO_Label=POWER_INT
PH15.GPIO_PuPd=GPIO_PULLUP
PH15.Signal=GPIO_Input
PH2.GPIO_Label=DAC8568_SCK
PH2.GPIO_PuPd=GPIO_PULLDOWN
PH2.Signal=GPIO_Output
PH3.GPIO_Label=DAC8568_DOUT
PH3.GPIO_PuPd=GPIO_PULLDOWN
PH3.Signal=GPIO_Output
PH4.GPIO_Label=DAC8568_NSS
PH4.Signal=GPIO_Output
PH5.GPIO_Label=MCU_BREAK_OUT
PH5.GPIO_PuPd=GPIO_PULLDOWN
PH5.Signal=GPIO_Output
PH6.GPIO_Label=TEC1_PWM
PH6.GPIO_PuPd=GPIO_PULLDOWN
PH6.Signal=GPIO_Output
PH7.GPIO_Label=TEC3_PWM
PH7.GPIO_PuPd=GPIO_PULLDOWN
PH7.Signal=GPIO_Output
PH8.GPIO_Label=TEC5_PWM
PH8.GPIO_PuPd=GPIO_PULLDOWN
PH8.Signal=GPIO_Output
PH9.GPIO_Label=TEC7_PWM
PH9.GPIO_PuPd=GPIO_PULLDOWN
PH9.Signal=GPIO_Output
PI0.GPIO_Label=MPU_SPI_NSS
PI0.GPIO_PuPd=GPIO_PULLUP
PI0.GPIO_Speed=GPIO_SPEED_FREQ_VERY_HIGH
PI0.Mode=NSS_Signal_Hard_Input
PI0.Signal=SPI2_NSS
PI1.GPIO_Label=MPU_SPI_SCK
PI1.GPIO_PuPd=GPIO_PULLDOWN
PI1.Mode=Full_Duplex_Slave
PI1.Signal=SPI2_SCK
PI10.GPIO_Label=HT_TRAFFIC
PI10.Signal=GPIO_Input
PI11.GPIO_Label=HUMIDITY_SENSOR
PI11.Signal=GPIO_Input
PI2.GPIO_Label=MPU_SPI_MISO
PI2.GPIO_PuPd=GPIO_PULLDOWN
PI2.Mode=Full_Duplex_Slave
PI2.Signal=SPI2_MISO
PI3.GPIO_Label=MPU_SPI_MOSI
PI3.GPIO_PuPd=GPIO_PULLDOWN
PI3.Mode=Full_Duplex_Slave
PI3.Signal=SPI2_MOSI
PI4.GPIO_Label=VBUS_FS_EN
PI4.GPIO_PuPd=GPIO_PULLDOWN
PI4.Signal=GPIO_Output
PI5.GPIO_Label=FAN2_PWM
PI5.GPIO_PuPd=GPIO_PULLUP
PI5.Signal=S_TIM8_CH1
PI6.GPIO_Label=FAN1_PWM
PI6.GPIO_PuPd=GPIO_PULLUP
PI6.Signal=S_TIM8_CH2
PI7.GPIO_Label=FAN0_PWM
PI7.GPIO_PuPd=GPIO_PULLUP
PI7.Signal=S_TIM8_CH3
ProjectManager.HeapSize=0x2000
ProjectManager.StackSize=0x2000
ProjectManager.TargetToolchain=MDK-ARM V5.32
RCC.48MHZClocksFreq_Value=48000000
RCC.AHBFreq_Value=168000000
RCC.APB1CLKDivider=RCC_HCLK_DIV4
RCC.APB1Freq_Value=42000000
RCC.APB1TimFreq_Value=84000000
RCC.APB2CLKDivider=RCC_HCLK_DIV2
RCC.APB2Freq_Value=84000000
RCC.APB2TimFreq_Value=168000000
RCC.CortexFreq_Value=168000000
RCC.HCLKFreq_Value=168000000
RCC.HSE_VALUE=25000000
RCC.HSI_VALUE=16000000
RCC.LSE_VALUE=32768
RCC.PLLM=25
RCC.PLLN=336
RCC.PLLQ=7
RCC.SYSCLKFreq_VALUE=168000000
RCC.SYSCLKSource=RCC_SYSCLKSOURCE_PLLCLK
RCC.VCOOutputFreq_Value=336000000
RTC.Format=RTC_FORMAT_BIN
SH.ADCx_IN0.0=ADC1_IN0,IN0
SH.ADCx_IN1.0=ADC1_IN1,IN1
SH.ADCx_IN10.0=ADC1_IN10,IN10
SH.ADCx_IN11.0=ADC1_IN11,IN11
SH.ADCx_IN12.0=ADC1_IN12,IN12
SH.ADCx_IN13.0=ADC1_IN13,IN13
SH.ADCx_IN14.0=ADC1_IN14,IN14
SH.ADCx_IN15.0=ADC1_IN15,IN15
SH.ADCx_IN2.0=ADC1_IN2,IN2
SH.ADCx_IN3.0=ADC1_IN3,IN3
SH.ADCx_IN6.0=ADC1_IN6,IN6
SH.ADCx_IN7.0=ADC1_IN7,IN7
SH.ADCx_IN8.0=ADC1_IN8,IN8
SH.ADCx_IN9.0=ADC1_IN9,IN9
SH.COMP_DAC1_group.0=DAC_OUT1,DAC_OUT1
SH.COMP_DAC2_group.0=DAC_OUT2,DAC_OUT2
SH.S_TIM5_CH3.0=TIM5_CH3,PWM Generation3 CH3
SH.S_TIM8_CH1.0=TIM8_CH1,PWM Generation1 CH1
SH.S_TIM8_CH2.0=TIM8_CH2,PWM Generation2 CH2
SH.S_TIM8_CH3.0=TIM8_CH3,PWM Generation3 CH3
SH.S_TIM9_CH2.0=TIM9_CH2,PWM Generation2 CH2
SPI2.Direction=SPI_DIRECTION_2LINES
SPI2.Mode=SPI_MODE_SLAVE
SPI2.VirtualNSS=VM_NSSHARD
SPI2.VirtualType=VM_SLAVE
SPI3.BaudRatePrescaler=SPI_BAUDRATEPRESCALER_8
SPI3.CalculateBaudRate=5.25 MBits/s
SPI3.Direction=SPI_DIRECTION_2LINES
SPI3.FirstBit=SPI_FIRSTBIT_MSB
SPI3.Mode=SPI_MODE_MASTER
SPI3.VirtualType=VM_MASTER
TIM10.Period=9
TIM10.Prescaler=167
TIM14.AutoReloadPreload=TIM_AUTORELOAD_PRELOAD_DISABLE
TIM14.Period=1000
TIM14.Prescaler=84
TIM5.AutoReloadPreload=TIM_AUTORELOAD_PRELOAD_ENABLE
TIM5.Channel-PWM\ Generation3\ CH3=TIM_CHANNEL_3
TIM5.Period=5000
TIM5.Prescaler=96
TIM7.AutoReloadPreload=TIM_AUTORELOAD_PRELOAD_ENABLE
TIM7.Period=1000
TIM7.Prescaler=84
TIM8.AutoReloadPreload=TIM_AUTORELOAD_PRELOAD_ENABLE
TIM8.Channel-PWM\ Generation1\ CH1=TIM_CHANNEL_1
TIM8.Channel-PWM\ Generation2\ CH2=TIM_CHANNEL_2
TIM8.Channel-PWM\ Generation3\ CH3=TIM_CHANNEL_3
TIM8.Period=100
TIM8.Prescaler=35
TIM9.AutoReloadPreload=TIM_AUTORELOAD_PRELOAD_ENABLE
TIM9.Channel-PWM\ Generation2\ CH2=TIM_CHANNEL_2
TIM9.Period=1000
TIM9.Prescaler=1000
UART5.VirtualMode=Asynchronous
USART1.VirtualMode=VM_ASYNC
USART3.VirtualMode=VM_ASYNC
USART6.VirtualMode=VM_ASYNC
USB_HOST.BSP.number=1
USB_HOST.USBH_HandleTypeDef-ALL_Classes_FS=hUsbHostFS
USB_HOST.VirtualModeFS=All_Classes
USB_HOST0.BSP.STBoard=false
USB_HOST0.BSP.api=Unknown
USB_HOST0.BSP.condition=ALL_SW_VBUS_DRIVE_FS \= false
USB_HOST0.BSP.instance=PI4
USB_HOST0.BSP.ip=GPIO
USB_HOST0.BSP.mode=Output
USB_HOST0.BSP.name=Drive_VBUS_FS
USB_HOST0.BSP.solution=PI4
USB_OTG_FS.VirtualMode=Host_Only
USB_OTG_FS.phy_itface=HCD_PHY_EMBEDDED
VP_ADC1_TempSens_Input.Mode=IN-TempSens
VP_ADC1_Vbat_Input.Mode=IN-Vbat
VP_ADC1_Vref_Input.Mode=IN-Vrefint
VP_CRC_VS_CRC.Mode=CRC_Activate
VP_FATFS_VS_USB.Mode=USB
VP_FREERTOS_VS_CMSIS_V2.Mode=CMSIS_V2
VP_RNG_VS_RNG.Mode=RNG_Activate
VP_RTC_VS_RTC_Activate.Mode=RTC_Enabled
VP_RTC_VS_RTC_Calendar.Mode=RTC_Calendar
VP_SYS_VS_tim13.Mode=TIM13
VP_TIM10_VS_ClockSourceINT.Mode=Enable_Timer
VP_TIM12_VS_ClockSourceINT.Mode=Internal
VP_TIM14_VS_ClockSourceINT.Mode=Enable_Timer
VP_TIM5_VS_ClockSourceINT.Mode=Internal
VP_TIM7_VS_ClockSourceINT.Mode=Enable_Timer
VP_TIM8_VS_ClockSourceINT.Mode=Internal
VP_TIM9_VS_ClockSourceINT.Mode=Internal
VP_USB_HOST_VS_USB_HOST_ALL_CLASS_FS.Mode=ALL_Classes_FS
board=custom

// file: Core/Src/main.c
/* USER CODE BEGIN Header */
/**
  ******************************************************************************
  * @file           : main.c
  * @brief          : Main program body
  ******************************************************************************
  * @attention
  *
  * Copyright (c) 2026 STMicroelectronics.
  * All rights reserved.
  *
  * This software is licensed under terms that can be found in the LICENSE file
  * in the root directory of this software component.
  * If no LICENSE file comes with this software, it is provided AS-IS.
  *
  ******************************************************************************
  */
/*----------------------------------------------------------------------------
 * 文件编码约定: 本文件为 UTF-8 编码(带BOM)。
 * 本工程源码统一使用 UTF-8(带BOM) 保存: 新建或修改任何源文件时,
 * 请以 UTF-8 编码保存, 并在文件头保留本注释;
 * 若保存成无BOM的 UTF-8, Keil 会按 GBK 解码, 中文注释将显示为乱码。
 * 本注释位于 USER CODE Header 区, CubeMX 重新生成代码时会保留。
 *----------------------------------------------------------------------------*/
/* USER CODE END Header */
#include "main.h"
#include "cmsis_os.h"
#include "adc.h"
#include "can.h"
#include "crc.h"
#include "dac.h"
#include "dma.h"
#include "fatfs.h"
#include "i2c.h"
#include "rng.h"
#include "rtc.h"
#include "spi.h"
#include "tim.h"
#include "usart.h"
#include "usb_host.h"
#include "gpio.h"

/* USER CODE BEGIN Includes */
#include "sPlc.h"
#include "boardConfig.h"
#include "modbus_slave_spi.h"

/* USER CODE END Includes */

/* USER CODE BEGIN PV */
#if defined(LYPE_MCU_2V0_TEST)
uint8_t ret;
int16_t temp_val, humi_val;
uint8_t ch;
uint16_t dac_table[] = {0, 16384, 32768, 49152, 65535};
uint8_t level_idx;
char test_msg[] = "USART 115200 Test\r\n";
uint8_t test_data[8] = {0x01, 0x02, 0x03, 0x04, 0x05, 0x06, 0x07, 0x08};
CAN_TxHeaderTypeDef   TxHeader;
uint32_t tx_mailbox;
uint8_t code0;

#endif
float temp;
DHT11_DataTypeDef dht11_data;

/* USER CODE END PV */

void SystemClock_Config(void);
void MX_FREERTOS_Init(void);
/* USER CODE BEGIN PFP */
HAL_StatusTypeDef SPI_Slave_StartDmaTx(void);

/* USER CODE END PFP */

int main(void)
{

  /* MCU Configuration--------------------------------------------------------*/

  /* Reset of all peripherals, Initializes the Flash interface and the Systick. */
  HAL_Init();

  /* Configure the system clock */
  SystemClock_Config();

  /* Initialize all configured peripherals */
  MX_GPIO_Init();
  MX_DMA_Init();
  MX_ADC1_Init();
  MX_CAN1_Init();
  MX_CAN2_Init();
  MX_CRC_Init();
  MX_DAC_Init();
  MX_I2C3_Init();
  MX_RNG_Init();
  MX_SPI2_Init();
  MX_SPI3_Init();
  MX_TIM12_Init();
  MX_UART5_Init();
  MX_USART1_UART_Init();
  MX_USART3_UART_Init();
  MX_USART6_UART_Init();
  MX_TIM5_Init();
  MX_TIM8_Init();
  MX_TIM9_Init();
  MX_FATFS_Init();
  MX_TIM7_Init();
  MX_TIM14_Init();
  MX_RTC_Init();
  MX_I2C2_Init();
  MX_TIM10_Init();
  /* USER CODE BEGIN 2 */

//	__HAL_TIM_SET_COUNTER(&htim10, 0);
////	HAL_TIM_Base_Stop_IT(&htim10);
//	HAL_TIM_Base_Start_IT(&htim10);
//
//
////	__HAL_SPI_ENABLE(&hspi2);  // 启用SPI2外设
//  __HAL_SPI_ENABLE_IT(&hspi2, ( SPI_IT_RXNE));
//  __HAL_SPI_DISABLE(&hspi2);
//
//  HAL_GPIO_WritePin(HDMI_VCC_EA_GPIO_Port, HDMI_VCC_EA_Pin, GPIO_PIN_SET);
//
//	CAN_Filter_Config();
//	SPI_Slave_WaitMasterCmd();
//
//		HAL_Delay(2000);
//    while (1)
//    {
//        uint8_t ret = DHT11_ReadData(&dht11_data);
//        if(ret == 0)
//        {
//            //读取成功，dht11_data.temp_int 温度；dht11_data.humi_int湿度
//        }
//        HAL_Delay(2000); //DHT11最小采样间隔1s，不可太快
//    }

//  while(1)
//	{

//    if(PCA9546_Init() == HAL_OK)
//    {
//        // 选择通道0
//        if(PCA9546_SelectChannel(PCA9546_CHANNEL_0) == HAL_OK)
//        {
//            // 读取当前通道状态，验证是否选择成功
//            uint8_t current_ch;
//            if(PCA9546_ReadChannel(&current_ch) == HAL_OK && current_ch == PCA9546_CHANNEL_0)
//            {
//									LM75A_Init(&hi2c2);
//
//									temp = LM75A_ReadTemperature(LM75A_A_I2C_ADDR);
//									if(temp > -900.0f)
//									{
//											// 读取成功，temp即为摄氏温度
//									}
//									HAL_Delay(200);
//									temp = LM75A_ReadTemperature(LM75A_B_I2C_ADDR);
//									if(temp > -900.0f)
//									{
//											// 读取成功，temp即为摄氏温度
//									}
//									HAL_Delay(200);
//									HAL_Delay(1000);
//
//            }
//        }
//
//    };
//
//	}

//  while(1)
//	{
////								if(spi_slave_state == SPI_SLAVE_STATE_IDLE)
////								{
////										/* 重新进入待命，等待下一次主机NSS拉低 */
////										SPI_Slave_WaitMasterCmd();
////								}
//

//								/* -------- SPI硬件错误 OVR/MODF/DMA错误处理 -------- */

//								if(spi_err_flag != 0)
//								{
//										spi_err_flag = 0;
//										SPI_StopFrameWatchdog();

//										HAL_SPI_Abort(&hspi2);
//										/* ---------- 第1步：停止DMA，解除HAL状态机锁定 ---------- */
//										HAL_SPI_DMAStop(&hspi2);

//										/* ---------- 第2步：禁用SPI外设 ---------- */
//										__HAL_SPI_DISABLE(&hspi2);

//										/* ---------- 第3步：清除所有错误标志 ---------- */
//										// OVR清除：先读DR，再读SR（HAL库的__HAL_SPI_CLEAR_OVRFLAG宏已封装）
//										__HAL_SPI_CLEAR_OVRFLAG(&hspi2);
//										// MODF清除：先读SR，再写CR1（HAL宏已封装）
//										__HAL_SPI_CLEAR_MODFFLAG(&hspi2);
//										// CRC错误（如果启用了CRC）
//										__HAL_SPI_CLEAR_CRCERRFLAG(&hspi2);
//										// 帧错误（TI模式下）
//										__HAL_SPI_CLEAR_FREFLAG(&hspi2);

//										/* ---------- 第4步：复位DMA流 ---------- */
//										// 这一步非常关键！DMA流如果不复位，重新使能会立即触发DMA错误
//										HAL_DMA_DeInit(hspi2.hdmatx);
//										HAL_DMA_DeInit(hspi2.hdmarx);
//										// 重新初始化DMA（调用你CubeMX生成的MX_DMA_Init()中的对应配置）
//										MX_DMA_Init();
//										// 重新关联DMA句柄到SPI
//										__HAL_LINKDMA(&hspi2, hdmatx, hdma_spi2_tx);  // 根据实际DMA句柄名修改
//										__HAL_LINKDMA(&hspi2, hdmarx, hdma_spi2_rx);

//										/* ---------- 第5步：重新初始化SPI外设 ---------- */
//										HAL_SPI_MspInit(&hspi2);
//										/* ---------- 第6步：重新启动DMA收发 ---------- */
//										// 从机模式必须用 TransmitReceive_DMA，不能只开接收
//										// 因为从机在接收的同时必须发送数据（全双工）
//										g_spi_status = HAL_SPI_TransmitReceive_DMA(&hspi2,  spi_tx_resp_buf, spi_rx_cmd_buf, SPI_RX_CMD_LEN);
////										SPI_StartFrameWatchdog(); /* 应答阶段重新开启帧看门狗 */
//										spi_abort_timeout_cnt++;

//
//										__HAL_SPI_ENABLE(&hspi2);  // 启用SPI2外设
//										__HAL_SPI_ENABLE_IT(&hspi2, ( SPI_IT_RXNE));
//
//
//										spi_slave_state = SPI_SLAVE_STATE_RX_CMD;
//							}

//
//	};

#if defined(LYPE_MCU_2V0_TEST)
	epromInit();
  listEpromTable();
//  sPlcEpromTest();

    // HDC1080初始化
    ret = hdc1080_init();
    if(ret == 0)
    {
        printf("HDC1080 init OK!\r\n");
    }
    else
    {
        printf("HDC1080 init FAIL!!! Check I2C wiring!\r\n");
    }

		// 读取温湿度
		hdc1080_read(&temp_val, &humi_val);

		/*
		 * temp_val = (温度 ×10)   例：253 → 25.3℃
		 * humi_val = (湿度 ×10)   例：452 → 45.2%RH
		 */
		printf("Temp: %d.%d ℃  | Humidity: %d.%d %%RH\r\n",
					 temp_val / 10, abs(temp_val) % 10,
					 humi_val / 10, humi_val % 10);

		HAL_Delay(1000); // 1秒刷新一次

    DAC8568_Init();

    // 设置通道A输出半量程（32768对应Vref/2）
    DAC8568_SetChannelVoltage(DAC8568_CH_A, 0x1000);
    DAC8568_SetChannelVoltage(DAC8568_CH_C, 0x2000);
    DAC8568_SetChannelVoltage(DAC8568_CH_E, 0x3000);
    DAC8568_SetChannelVoltage(DAC8568_CH_G, 0x4000);
    // 设置通道B输出满量程（65535对应Vref）
    DAC8568_SetChannelVoltage(DAC8568_CH_B, 0x8000);
    DAC8568_SetChannelVoltage(DAC8568_CH_D, 0x9000);
    DAC8568_SetChannelVoltage(DAC8568_CH_F, 0xa000);
    DAC8568_SetChannelVoltage(DAC8568_CH_H, 0xb000);

    // 清除所有通道输出
    DAC8568_ClearAllChannels();

		DAC_TEC_SetChannel1Voltage(2.5f);  // PA4输出1.5V
		DAC_TEC_SetChannel2Voltage(2.0f);  // PA5输出2.0V

		DAC_TEC_SetChannel1Voltage(0.0f);
		DAC_TEC_SetChannel2Voltage(0.0f);

    // 初始化PCA9546（自动完成复位引脚配置、硬件复位、通道复位）
    if(PCA9546_Init() == HAL_OK)
    {
        // 选择通道0
        if(PCA9546_SelectChannel(PCA9546_CHANNEL_0) == HAL_OK)
        {
            // 读取当前通道状态，验证是否选择成功
            uint8_t current_ch;
            if(PCA9546_ReadChannel(&current_ch) == HAL_OK && current_ch == PCA9546_CHANNEL_0)
            {
//                // 通道0选择成功，可执行后续I2C设备操作
//								PCA9546_HardwareReset();
									DAC5578_Init();
									HAL_Delay(500);
									code0 = DAC5578_VolToCode(0.50f, 5.0f);
									DAC5578_SetChannel(DAC5578_CH_A, code0);
									code0 = DAC5578_VolToCode(1.00f, 5.0f);
									DAC5578_SetChannel(DAC5578_CH_B, code0);
									code0 = DAC5578_VolToCode(1.50f, 5.0f);
									DAC5578_SetChannel(DAC5578_CH_C, code0);
									code0 = DAC5578_VolToCode(2.00f, 5.0f);
									DAC5578_SetChannel(DAC5578_CH_D, code0);
									code0 = DAC5578_VolToCode(2.50f, 5.0f);
									DAC5578_SetChannel(DAC5578_CH_E, code0);
									code0 = DAC5578_VolToCode(3.00f, 5.0f);
									DAC5578_SetChannel(DAC5578_CH_F, code0);
									code0 = DAC5578_VolToCode(3.50f, 5.0f);
									DAC5578_SetChannel(DAC5578_CH_G, code0);
									code0 = DAC5578_VolToCode(4.00f, 5.0f);
									DAC5578_SetChannel(DAC5578_CH_H, code0);

									HAL_Delay(1000);
									LM75A_Init(&hi2c2);

									temp = LM75A_ReadTemperature(LM75A_A_I2C_ADDR);
									if(temp > -900.0f)
									{
											// 读取成功，temp即为摄氏温度
									}
									HAL_Delay(200);
									temp = LM75A_ReadTemperature(LM75A_B_I2C_ADDR);
									if(temp > -900.0f)
									{
											// 读取成功，temp即为摄氏温度
									}
									HAL_Delay(200);
            }
        }
    };

		//RS232 COM TX
		HAL_UART_Transmit(&huart3, (uint8_t*)test_msg, sizeof(test_msg)-1, 100);
		//RS232 COM TX
		HAL_UART_Transmit(&huart6, (uint8_t*)test_msg, sizeof(test_msg)-1, 100);

  /* 发送头配置（标准ID、数据帧、无扩展ID） */
  TxHeader.StdId = 0x123;          // 标准ID（0-0x7FF）
  TxHeader.ExtId = 0;            // 扩展ID禁用
  TxHeader.RTR = CAN_RTR_DATA;      // 数据帧（非远程帧）
  TxHeader.IDE = CAN_ID_STD;        // 标准ID格式
  TxHeader.DLC = 8;               // 数据长度（1-8）
  TxHeader.TransmitGlobalTime = DISABLE;
  do
	{
	 /* 发送数据 */
		if (HAL_CAN_AddTxMessage(&hcan1, &TxHeader, test_data, &tx_mailbox) != HAL_OK) {
        printf("can1 FAIL!!!\r\n");
		}

		if (HAL_CAN_AddTxMessage(&hcan2, &TxHeader, test_data, &tx_mailbox) != HAL_OK) {
        printf("can2 FAIL!!!\r\n");
		}
		HAL_Delay(1000); // 1秒刷新一次
	}while(1);

	TPL0501_SetWiper(0xff);
	TPL0501_SetWiper(0xff);

  HAL_GPIO_WritePin(HDMI_VCC_EA_GPIO_Port, HDMI_VCC_EA_Pin, GPIO_PIN_SET);

#endif
  HAL_GPIO_WritePin(HDMI_VCC_EA_GPIO_Port, HDMI_VCC_EA_Pin, GPIO_PIN_SET);

  /* USER CODE END 2 */

  /* Init scheduler */
  osKernelInitialize();  /* Call init function for freertos objects (in cmsis_os2.c) */
  MX_FREERTOS_Init();

  /* Start scheduler */
  osKernelStart();

  /* We should never get here as control is now taken by the scheduler */

  /* Infinite loop */
  while (1)
  {

  }
}

void SystemClock_Config(void)
{
  RCC_OscInitTypeDef RCC_OscInitStruct = {0};
  RCC_ClkInitTypeDef RCC_ClkInitStruct = {0};

  /** Configure the main internal regulator output voltage
  */
  __HAL_RCC_PWR_CLK_ENABLE();
  __HAL_PWR_VOLTAGESCALING_CONFIG(PWR_REGULATOR_VOLTAGE_SCALE1);

  /** Initializes the RCC Oscillators according to the specified parameters
  * in the RCC_OscInitTypeDef structure.
  */
  RCC_OscInitStruct.OscillatorType = RCC_OSCILLATORTYPE_LSI|RCC_OSCILLATORTYPE_HSE;
  RCC_OscInitStruct.HSEState = RCC_HSE_ON;
  RCC_OscInitStruct.LSIState = RCC_LSI_ON;
  RCC_OscInitStruct.PLL.PLLState = RCC_PLL_ON;
  RCC_OscInitStruct.PLL.PLLSource = RCC_PLLSOURCE_HSE;
  RCC_OscInitStruct.PLL.PLLM = 25;
  RCC_OscInitStruct.PLL.PLLN = 336;
  RCC_OscInitStruct.PLL.PLLP = RCC_PLLP_DIV2;
  RCC_OscInitStruct.PLL.PLLQ = 7;
  if (HAL_RCC_OscConfig(&RCC_OscInitStruct) != HAL_OK)
  {
    Error_Handler();
  }

  /** Initializes the CPU, AHB and APB buses clocks
  */
  RCC_ClkInitStruct.ClockType = RCC_CLOCKTYPE_HCLK|RCC_CLOCKTYPE_SYSCLK
                              |RCC_CLOCKTYPE_PCLK1|RCC_CLOCKTYPE_PCLK2;
  RCC_ClkInitStruct.SYSCLKSource = RCC_SYSCLKSOURCE_PLLCLK;
  RCC_ClkInitStruct.AHBCLKDivider = RCC_SYSCLK_DIV1;
  RCC_ClkInitStruct.APB1CLKDivider = RCC_HCLK_DIV4;
  RCC_ClkInitStruct.APB2CLKDivider = RCC_HCLK_DIV2;

  if (HAL_RCC_ClockConfig(&RCC_ClkInitStruct, FLASH_LATENCY_5) != HAL_OK)
  {
    Error_Handler();
  }
}

/* USER CODE BEGIN 4 */

//接收中断回调
void HAL_CAN_RxFifo0MsgPendingCallback(CAN_HandleTypeDef *hcan)
{
  CAN_RxHeaderTypeDef rx_header;
  uint8_t rx_data[8];

  if(HAL_CAN_GetRxMessage(hcan, CAN_RX_FIFO0, &rx_header, rx_data) == HAL_OK)
  {
    /* 判断是CAN1还是CAN2 */
    if(hcan->Instance == CAN1)
    {
        //======== CAN1 接收处理 =========
        //rx_header.StdId  标准ID
        //rx_header.ExtId  扩展ID
        //rx_header.IDE    CAN_ID_STD / CAN_ID_EXT
        //rx_header.RTR    CAN_RTR_DATA / CAN_RTR_REMOTE
        //rx_header.DLC    数据长度 0~8
        //rx_data[]        接收数据

        if(rx_header.IDE == CAN_ID_STD)
        {
            uint16_t can1_std_id = rx_header.StdId;
            switch(can1_std_id)
            {
                case 0x123:
                    break;
                default:
                    break;
            }
        }
    }
    else if(hcan->Instance == CAN2)
    {
        //======== CAN2 接收处理 =========
        if(rx_header.IDE == CAN_ID_STD)
        {
            uint16_t can2_std_id = rx_header.StdId;
            switch(can2_std_id)
            {
                case 0x200:
                    break;
                default:
                    break;
            }
        }
    }
  }
}

/**
 * @brief  SPI DMA发送完成中断回调
 * @param  hspi : SPI句柄指针
 */
void HAL_SPI_TxCpltCallback(SPI_HandleTypeDef *hspi)
{
  if(hspi->Instance == SPI2)
  {
  }
}

/* USER CODE END 4 */

void HAL_TIM_PeriodElapsedCallback(TIM_HandleTypeDef *htim)
{
  if (htim->Instance == TIM13)
  {
    HAL_IncTick();
  }
  /* USER CODE BEGIN Callback 1 */
	if(htim->Instance == CONFIG_SPLC_TIM) {
		sPlcTimerIsr();
	}
	if(htim->Instance == CONFIG_LASER_TIM){
		sPlcLaserTimerIsr();
	}
	if(htim->Instance == CONFIG_SPI2_TIM){
/* 看门狗溢出，SPI帧传输超时 */
		__HAL_TIM_SET_COUNTER(&htim10, 0);
		if (spi_frame_timeout_cnt > 0)
		{
			  spi_frame_timeout_cnt = 0;
    }
		else
		{
			  spi_err_flag = 1;
		};

	}

  /* USER CODE END Callback 1 */
}

void Error_Handler(void)
{
  __disable_irq();
  while (1)
  {
  }
}
